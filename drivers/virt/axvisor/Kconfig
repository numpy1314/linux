## drivers/virt/axvisor/Kconfig
```kconfig
config AXVISOR_ARM64_VHE_PROBE
	bool "AxVisor ARM64 read-only VHE preflight probe"
	depends on ARM64
	default n
	help
	  Sample the current execution level and virtualization features on
	  every online CPU without installing vectors or entering a guest.
	  This does not build the Rust bridge or authorize later guest entry.
	  The initial candidate profile requires 4 KiB pages, a DT GICv3,
	  and CONFIG_KVM=n. Unsupported systems are logged and left unchanged.

config AXVISOR_LINUX_BRIDGE
	bool "AxVisor Linux host bridge"
	select AXVISOR_LINUX_WAIT
	default n
	help
	  Build the Linux host provider and link the no_std AxVisor Rust domain
	  into the kernel.

config AXVISOR_LINUX_CONTROL
	bool "AxVisor Linux control endpoint"
	depends on AXVISOR_LINUX_BRIDGE
	select MISC_DEVICES
	default n
	help
	  Publish AxVisor's KVM-compatible control endpoint as /dev/kvm.

config AXVISOR_ARM64_VHE
	bool "AxVisor Linux VHE ownership boundary"
	depends on ARM64 && AXVISOR_LINUX_CONTROL && !KVM && ARM64_4K_PAGES
	depends on KERNEL_MODE_NEON && !ARM64_PSEUDO_NMI
	default n
	help
	  Requires the Rust arm-vhe feature, Linux 6.12 schedulable kernel SIMD,
	  and a DT GICv3 host running Linux at EL2. The guest CPU pool must have
	  identical CPU profiles; set axvisor_linux.guest_cpus and userspace
	  affinity explicitly on heterogeneous hosts. Each control ioctl stays
	  on its entry CPU while permitting scheduling. Native KVM, CPU hotplug,
	  pseudo-NMI, SME, MTE and POE are not supported in this profile.
	  This candidate supports the control endpoint;
	  the direct static-VM boot path is not admitted. Kernel SIMD ownership
	  remains schedulable while Core protects each guest-switch batch.
	  Admission fails before publishing the endpoint on unsupported hosts.

config AXVISOR_LINUX_CONFORMANCE
	bool "AxVisor host-contract conformance runner"
	depends on AXVISOR_LINUX_BRIDGE
	default n
	help
	  Build the host-only runner for the shared AxVisor contract tests.

config AXVISOR_LINUX_WAIT
	bool

config AXVISOR_LINUX_WAIT_KUNIT_TEST
	bool "Test AxVisor Linux wait queue notification ordering"
	depends on KUNIT=y
	select AXVISOR_LINUX_WAIT
	default n
	help
	  Exercise the actual Linux wait queue implementation without linking
	  the Rust bridge or enabling virtualization. Includes a recoverable
	  negative control for the old predicate-then-generation ordering.
```
